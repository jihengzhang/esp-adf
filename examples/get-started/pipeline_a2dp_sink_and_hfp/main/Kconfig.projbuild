## examples/get-started/pipeline_a2dp_sink_and_hfp/main/Kconfig.projbuild
```kconfig
menu "Example Options"

config PAIRING_LED_ENABLE
    bool "Enable LED blink during pairing state"
    default n
    help
        If enabled, the application will toggle a GPIO at 1 Hz while the device (Added by jizh)
        is in pairing (discoverable + connectable) state.

config PAIRING_LED_GPIO
    int "GPIO number for pairing LED"
    depends on PAIRING_LED_ENABLE
    range 0 48
    default 2
    help
        Select the GPIO used to drive a status LED for pairing indication.

endmenu
```
